// File generated 2022. 05. 21. 21:49:31
// Warning! This is a generated file, any manual changes will be
// lost during the next generation.

#constant  Strings0Count    1
#constant  Strings0Size     20
#constant  Strings1Count    1
#constant  Strings1Size     20
#constant  Strings20Count    2
#constant  Strings20Size     4
#constant  Strings21Count    2
#constant  Strings21Size     4
#constant  Strings16Count    0
#constant  Strings16Size     1
#constant  Strings17Count    0
#constant  Strings17Size     1
#constant  Strings14Count    0
#constant  Strings14Size     1
#constant  Strings15Count    0
#constant  Strings15Size     1
#constant  Strings2Count    2
#constant  Strings2Size     9
#constant  Strings3Count    2
#constant  Strings3Size     9
#constant  Strings4Count    0
#constant  Strings4Size     1
#constant  Strings5Count    0
#constant  Strings5Size     1
#constant  Strings6Count    0
#constant  Strings6Size     1
#constant  Strings7Count    0
#constant  Strings7Size     1
#constant  Strings8Count    0
#constant  Strings8Size     1
#constant  Strings9Count    0
#constant  Strings9Size     1
#constant  Strings10Count    6
#constant  Strings10Size     39
#constant  Strings11Count    0
#constant  Strings11Size     1
#constant  Strings22Count    12
#constant  Strings22Size     343
#constant  Strings23Count    12
#constant  Strings23Size     38
#constant  Strings12Count    1
#constant  Strings12Size     138
#constant  Strings13Count    0
#constant  Strings13Size     1
#constant  Strings19Count    1
#constant  Strings19Size     34
#constant  Strings18Count    3
#constant  Strings18Size     103
#DATA
    byte iKeyboard0keystrokes 0x31, 0x32, 0x33, 0x34, 0x35, 0x36, 0x37, 0x38, 0x39, 0x30, 0x63, 0x6F, 0xB0
#END


#constant  IFONT_OFFSET     24
// object indexes into ImageControl
#CONST
    iWinbutton0     // offset 0x0
    iWinbutton1     // offset 0x12800
    iStatictext0    // offset 0x1B200
    iWinbutton2     // offset 0x1F600
    iStatictext1    // offset 0x31E00
    iStatictext2    // offset 0x33C00
    iStatictext3    // offset 0x36000
    i4Dbutton2      // offset 0x37600
    i4Dbutton3      // offset 0x3BC00
    iStatictext23   // offset 0x40200
    iStatictext24   // offset 0x41600
    iUserled3       // offset 0x42C00
    iUserled2       // offset 0x43600
    iStatictext25   // offset 0x44000
    iWinbutton3     // offset 0x45000
    iWinbutton4     // offset 0x50600
    iWinbutton5     // offset 0x55E00
    iWinbutton6     // offset 0x5B600
    iWinbutton7     // offset 0x60E00
    iWinbutton8     // offset 0x66600
    iStatictext4    // offset 0x6BE00
    iStatictext19   // offset 0x6E200
    iStatictext20   // offset 0x6FE00
    iUserled1       // offset 0x71E00
    iStatictext21   // offset 0x72800
    iWinbutton9     // offset 0x73200
    iWinbutton10    // offset 0x78A00
    iWinbutton11    // offset 0x7E200
    iWinbutton12    // offset 0x83A00
    iWinbutton13    // offset 0x89200
    iUserled0       // offset 0x94800
    iStatictext5    // offset 0x95200
    iStatictext6    // offset 0x95C00
    iStatictext7    // offset 0x97400
    iStatictext8    // offset 0x99400
    iWinbutton14    // offset 0x9B000
    iWinbutton15    // offset 0x9D000
    iWinbutton16    // offset 0xA0600
    iWinbutton17    // offset 0xA3C00
    iWinbutton18    // offset 0xA7200
    iStatictext9    // offset 0xA9200
    i4Dbutton0      // offset 0xAA600
    iStatictext10   // offset 0xAEC00
    iStatictext11   // offset 0xB0200
    iStatictext12   // offset 0xB3200
    i4Dbutton1      // offset 0xB6E00
    iWinbutton19    // offset 0xBB400
    iWinbutton20    // offset 0xBEA00
    iWinbutton21    // offset 0xC2000
    iWinbutton22    // offset 0xC5600
    iWinbutton23    // offset 0xC7600
    iWinbutton24    // offset 0xC9600
    iWinbutton25    // offset 0xCB600
    iStatictext13   // offset 0xCD600
    iStatictext14   // offset 0xCEE00
    iStatictext15   // offset 0xD0A00
    iStatictext16   // offset 0xD4400
    iKeyboard0      // offset 0xD8000
    iKeyboard0_0    // offset 0xF4400
    iKeyboard0_1    // offset 0xF8200
    iKeyboard0_2    // offset 0xFC000
    iKeyboard0_3    // offset 0xFFE00
    iKeyboard0_4    // offset 0x103C00
    iKeyboard0_5    // offset 0x107A00
    iKeyboard0_6    // offset 0x10B800
    iKeyboard0_7    // offset 0x10F600
    iKeyboard0_8    // offset 0x113400
    iKeyboard0_9    // offset 0x117200
    iKeyboard0_10   // offset 0x11B000
    iKeyboard0_11   // offset 0x122A00
    iKeyboard0_12   // offset 0x12A400
    iWinbutton26    // offset 0x12E200
    iWinbutton27    // offset 0x137800
    iWinbutton28    // offset 0x140E00
    iWinbutton32    // offset 0x14A400
    iWinbutton31    // offset 0x153A00
    iWinbutton37    // offset 0x15D000
    iUserimages0    // offset 0x166600
    iWinbutton34    // offset 0x1B4600
    iWinbutton35    // offset 0x1B6600
    iWinbutton36    // offset 0x1B8600
    iWinbutton33    // offset 0x1BA600
    iStatictext22   // offset 0x1BDC00
#END


#constant  Strings0StartH   0x0
#constant  Strings0StartL   0x0
#constant  Strings1StartH   0x0
#constant  Strings1StartL   0x200
#constant  Strings20StartH   0x0
#constant  Strings20StartL   0x400
#constant  Strings21StartH   0x0
#constant  Strings21StartL   0x600
#constant  Strings16StartH   0x0
#constant  Strings16StartL   0x800
#constant  Strings17StartH   0x0
#constant  Strings17StartL   0xA00
#constant  Strings14StartH   0x0
#constant  Strings14StartL   0xC00
#constant  Strings15StartH   0x0
#constant  Strings15StartL   0xE00
#constant  Strings2StartH   0x0
#constant  Strings2StartL   0x1000
#constant  Strings3StartH   0x0
#constant  Strings3StartL   0x1200
#constant  Strings4StartH   0x0
#constant  Strings4StartL   0x1400
#constant  Strings5StartH   0x0
#constant  Strings5StartL   0x1600
#constant  Strings6StartH   0x0
#constant  Strings6StartL   0x1800
#constant  Strings7StartH   0x0
#constant  Strings7StartL   0x1A00
#constant  Strings8StartH   0x0
#constant  Strings8StartL   0x1C00
#constant  Strings9StartH   0x0
#constant  Strings9StartL   0x1E00
#constant  Strings10StartH   0x0
#constant  Strings10StartL   0x2000
#constant  Strings11StartH   0x0
#constant  Strings11StartL   0x2200
#constant  Strings22StartH   0x0
#constant  Strings22StartL   0x2400
#constant  Strings23StartH   0x0
#constant  Strings23StartL   0x3600
#constant  Strings12StartH   0x0
#constant  Strings12StartL   0x3800
#constant  Strings13StartH   0x0
#constant  Strings13StartL   0x3A00
#constant  Strings19StartH   0x0
#constant  Strings19StartL   0x3C00
#constant  Strings18StartH   0x0
#constant  Strings18StartL   0x3E00

#IFNOT EXISTS NOGLOBALS
var hndl ;
var hFonts[24] ;
var oKeyboard0[12] := [-1, 0, 0, 0, 0, 255, 255, 255, 255, 255, 13, 0] ;
#ENDIF
