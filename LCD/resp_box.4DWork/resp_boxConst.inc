// File generated 2022. 05. 17. 10:37:54
// Warning! This is a generated file, any manual changes will be
// lost during the next generation.

#constant  Strings0Count    1
#constant  Strings0Size     12
#constant  Strings1Count    1
#constant  Strings1Size     12
#constant  Strings16Count    1
#constant  Strings16Size     12
#constant  Strings17Count    1
#constant  Strings17Size     12
#constant  Strings14Count    1
#constant  Strings14Size     12
#constant  Strings15Count    1
#constant  Strings15Size     12
#constant  Strings2Count    2
#constant  Strings2Size     4
#constant  Strings3Count    2
#constant  Strings3Size     4
#constant  Strings4Count    0
#constant  Strings4Size     1
#constant  Strings5Count    0
#constant  Strings5Size     1
#constant  Strings6Count    0
#constant  Strings6Size     1
#constant  Strings7Count    0
#constant  Strings7Size     1
#constant  Strings8Count    0
#constant  Strings8Size     1
#constant  Strings9Count    0
#constant  Strings9Size     1
#constant  Strings10Count    7
#constant  Strings10Size     39
#constant  Strings11Count    0
#constant  Strings11Size     1
#constant  Strings12Count    1
#constant  Strings12Size     138
#constant  Strings13Count    1
#constant  Strings13Size     15
#constant  Strings19Count    1
#constant  Strings19Size     34
#constant  Strings18Count    3
#constant  Strings18Size     103
#DATA
    byte iKeyboard0keystrokes 0x31, 0x32, 0x33, 0x34, 0x35, 0x36, 0x37, 0x38, 0x39, 0x30, 0x63, 0x6F, 0xB0
#END


#constant  IFONT_OFFSET     18
// object indexes into ImageControl
#CONST
    iWinbutton0     // offset 0x0
    iWinbutton1     // offset 0x14600
    iStatictext0    // offset 0x1DC00
    iWinbutton2     // offset 0x22000
    iStatictext1    // offset 0x36600
    iStatictext2    // offset 0x38400
    iStatictext3    // offset 0x3A800
    iWinbutton3     // offset 0x3CA00
    iWinbutton4     // offset 0x48000
    iWinbutton5     // offset 0x4D800
    iWinbutton6     // offset 0x53000
    iWinbutton7     // offset 0x58800
    iWinbutton8     // offset 0x5E000
    iStatictext4    // offset 0x63800
    iStatictext19   // offset 0x65A00
    iStatictext20   // offset 0x67800
    iUserled1       // offset 0x69C00
    iStatictext21   // offset 0x6B000
    iWinbutton9     // offset 0x6BC00
    iWinbutton10    // offset 0x71400
    iWinbutton11    // offset 0x76C00
    iWinbutton12    // offset 0x7C400
    iWinbutton13    // offset 0x81C00
    iUserled0       // offset 0x8D200
    iStatictext5    // offset 0x8E600
    iStatictext6    // offset 0x8F200
    iStatictext7    // offset 0x91E00
    iStatictext8    // offset 0x94200
    iWinbutton14    // offset 0x96000
    iWinbutton15    // offset 0x98000
    iWinbutton16    // offset 0x9B600
    iWinbutton17    // offset 0x9EC00
    iWinbutton18    // offset 0xA2200
    iStatictext9    // offset 0xA4200
    i4Dbutton0      // offset 0xA5600
    iStatictext10   // offset 0xA9C00
    iStatictext11   // offset 0xAB200
    iStatictext12   // offset 0xAE200
    i4Dbutton1      // offset 0xB1800
    iWinbutton19    // offset 0xB5E00
    iWinbutton20    // offset 0xB9400
    iWinbutton21    // offset 0xBCA00
    iWinbutton22    // offset 0xC0000
    iWinbutton23    // offset 0xC2000
    iWinbutton24    // offset 0xC4000
    iWinbutton25    // offset 0xC6000
    iStatictext13   // offset 0xC8000
    iStatictext14   // offset 0xC9800
    iStatictext15   // offset 0xCB400
    iStatictext16   // offset 0xCEE00
    iKeyboard0      // offset 0xD2600
    iKeyboard0_0    // offset 0xEEA00
    iKeyboard0_1    // offset 0xF2800
    iKeyboard0_2    // offset 0xF6600
    iKeyboard0_3    // offset 0xFA400
    iKeyboard0_4    // offset 0xFE200
    iKeyboard0_5    // offset 0x102000
    iKeyboard0_6    // offset 0x105E00
    iKeyboard0_7    // offset 0x109C00
    iKeyboard0_8    // offset 0x10DA00
    iKeyboard0_9    // offset 0x111800
    iKeyboard0_10   // offset 0x115600
    iKeyboard0_11   // offset 0x11D000
    iKeyboard0_12   // offset 0x124A00
    iWinbutton26    // offset 0x128800
    iWinbutton27    // offset 0x131E00
    iWinbutton28    // offset 0x13B400
    iWinbutton32    // offset 0x144A00
    iWinbutton31    // offset 0x14E000
    iTrackbar0      // offset 0x157600
    iWinbutton29    // offset 0x225C00
    iWinbutton30    // offset 0x229200
    iStatictext17   // offset 0x22C800
    iStatictext18   // offset 0x22E400
    iWinbutton33    // offset 0x22EA00
    iStatictext22   // offset 0x232000
#END


#constant  Strings0StartH   0x0
#constant  Strings0StartL   0x0
#constant  Strings1StartH   0x0
#constant  Strings1StartL   0x200
#constant  Strings16StartH   0x0
#constant  Strings16StartL   0x400
#constant  Strings17StartH   0x0
#constant  Strings17StartL   0x600
#constant  Strings14StartH   0x0
#constant  Strings14StartL   0x800
#constant  Strings15StartH   0x0
#constant  Strings15StartL   0xA00
#constant  Strings2StartH   0x0
#constant  Strings2StartL   0xC00
#constant  Strings3StartH   0x0
#constant  Strings3StartL   0xE00
#constant  Strings4StartH   0x0
#constant  Strings4StartL   0x1000
#constant  Strings5StartH   0x0
#constant  Strings5StartL   0x1200
#constant  Strings6StartH   0x0
#constant  Strings6StartL   0x1400
#constant  Strings7StartH   0x0
#constant  Strings7StartL   0x1600
#constant  Strings8StartH   0x0
#constant  Strings8StartL   0x1800
#constant  Strings9StartH   0x0
#constant  Strings9StartL   0x1A00
#constant  Strings10StartH   0x0
#constant  Strings10StartL   0x1C00
#constant  Strings11StartH   0x0
#constant  Strings11StartL   0x1E00
#constant  Strings12StartH   0x0
#constant  Strings12StartL   0x2000
#constant  Strings13StartH   0x0
#constant  Strings13StartL   0x2200
#constant  Strings19StartH   0x0
#constant  Strings19StartL   0x2400
#constant  Strings18StartH   0x0
#constant  Strings18StartL   0x2600

#IFNOT EXISTS NOGLOBALS
var hndl ;
var hFonts[20] ;
var oKeyboard0[12] := [-1, 0, 0, 0, 0, 255, 255, 255, 255, 255, 13, 0] ;
#ENDIF
